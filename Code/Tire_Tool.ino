//<App !Start!>
// FILE: [TireToolFinal.ino]
// Created by GUIslice Builder version: [0.16.b004]
//
// GUIslice Builder Generated File
//
// For the latest guides, updates and support view:
// https://github.com/ImpulseAdventure/GUIslice
//
//<App !End!>

// ------------------------------------------------
// Headers to include
// ------------------------------------------------
#include "TireToolFinal_GSLC.h"
#include "SD.h"
#include "Adafruit_AMG88xx.h"
Adafruit_AMG88xx amg;
#include "RTClib.h"
RTC_DS1307 rtc;
#include "SparkFun_MCP9600.h"
MCP9600 probe;
#include "Honeywell_ABP.h"
Honeywell_ABP abp(0x28,0,60,"psi");


// ------------------------------------------------
// Program Globals
// ------------------------------------------------
bool pauseTemp = false;
bool pausePressure = false;
unsigned long screensaverTimer;
unsigned long refreshTimer;
unsigned long currentMillis;
const uint16_t Minutes = 60000;
const uint8_t Halfseconds = 500;
uint8_t lastPageId = PG_Home;

// ------------------------------------------------
// Temperature Probe Globals
// ------------------------------------------------
char  tempBuf [8];
int16_t gaugeVal;
float   probeTemp;


// ------------------------------------------------
// Pressure Gauge Globals
// ------------------------------------------------
char  pressureBuf [8];
float    gaugePressure;
float    sensorPressure;


// ------------------------------------------------
// Data Log Globals
// ------------------------------------------------
char   logTemp[5];
char   logFolder[MAX_STR];
char   logName[MAX_STR];
char   logPath[MAX_STR];
char   LogInfoBuf [MAX_STR];
char   averageBuf [7];
char   deltaBuf [MAX_STR];
char   trackTempBuf [MAX_STR];
char   ambTempBuf [MAX_STR];
const char* dateBuf;
static char nullnullval[7] = "---.--";
const uint8_t   Left = 0;
const uint8_t   Rear = 1;
const uint8_t   Right = 2;
const uint8_t   Front = 3;
const uint8_t   FrontLeft = 0;
const uint8_t   RearLeft = 1;
const uint8_t   RearRight = 2;
const uint8_t   FrontRight = 3;
const uint8_t   numberLogLines (15);
int8_t  ambTemp;
int8_t  counter = -1;
int16_t  dataFieldInt [12];
int16_t  cornerAverage [4];
int16_t  cornerHighTemp[4];
int16_t  cornerLowTemp[4];
float  cornerDelta [4];
float  sideAverage [4];


// ------------------------------------------------
// Thermal Camera Globals
// ------------------------------------------------
#define AMG_COLS 8
#define AMG_ROWS 8
bool pauseThermal = false;
bool autoScale = false;
bool cursorOn = true;
bool DefaultTemp = true;
char  scaleRangeBuf[3];
char  minTempBuf [3];
char  maxTempBuf [3];
char  cursorTempBuf [5];
int8_t  MINTEMP = 20;
int8_t  MAXTEMP = 30;
uint8_t  thermalCol;
uint8_t  thermalSel;
uint8_t  scaleRange = 4;
uint8_t  INTERPOLATED_COLS = 36;
uint8_t  INTERPOLATED_ROWS = 36;
uint8_t  boxWidth = 7;
uint8_t  boxHeight = 5;
uint8_t  red, green, blue;
uint16_t   colorMap;
float  colorTemp;
float  cursorTemp;
float  pixels[AMG_COLS * AMG_ROWS];
float  dest_2d[3780]; //array size must match the largest number of rows * columns that can be encountered during runtime
float  get_point(float *p, uint8_t rows, uint8_t cols, int8_t x, int8_t y);
float  cubicInterpolate(float p[], float x);
float  bicubicInterpolate(float p[], float x, float y);
void set_point(float *p, uint8_t rows, uint8_t cols, int8_t x, int8_t y, float f);
void get_adjacents_1d(float *src, float *dest, uint8_t rows, uint8_t cols, int8_t x, int8_t y);
void get_adjacents_2d(float *src, float *dest, uint8_t rows, uint8_t cols, int8_t x, int8_t y);
void interpolate_image(float *src, uint8_t src_rows, uint8_t src_cols, float *dest, uint8_t dest_rows, uint8_t dest_cols);



const uint32_t colorPallete [][433] = {

  //IRONBOW
  { 0x00000a, 0x000014, 0x00001e, 0x000025, 0x00002a, 0x00002e, 0x000032, 0x000036, 0x00003a, 0x00003e, 0x000042,
    0x000046, 0x00004a, 0x00004f, 0x000052, 0x010055, 0x010057, 0x020059, 0x02005c, 0x03005e, 0x040061, 0x040063,
    0x050065, 0x060067, 0x070069, 0x08006b, 0x09006e, 0x0a0070, 0x0b0073, 0x0c0074, 0x0d0075, 0x0d0076, 0x0e0077,
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    0xfffeee, 0xfffef1, 0xfffef4, 0xfffff6,
  },

  //RAINBOW
  { 0xFF, 0x2FF, 0x5FF, 0x8FF, 0xBFF, 0xEFF, 0x11FF, 0x14FF, 0x17FF, 0x1AFF, 0x1DFF,
    0x20FF, 0x23FF, 0x26FF, 0x29FF, 0x2CFF, 0x2FFF, 0x32FF, 0x35FF, 0x37FF, 0x3AFF, 0x3DFF,
    0x40FF, 0x43FF, 0x46FF, 0x49FF, 0x4CFF, 0x4FFF, 0x52FF, 0x55FF, 0x58FF, 0x5BFF, 0x5EFF,
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    0xFF00E4, 0xFF00E7, 0xFF00EA, 0xFF00ED,
  },

  //RAINBOW HC
  { 0x96, 0x310296, 0x310496, 0x300696, 0x300896, 0x2F0B96, 0x2F0D96, 0x2E0F96, 0x2E1196, 0x2D1396, 0x2D1696,
    0x2C1896, 0x2C1A96, 0x2B1C96, 0x2B1F96, 0x2B2196, 0x2A2396, 0x2A2596, 0x292796, 0x292A96, 0x282C96, 0x282E96,
    0x273096, 0x273296, 0x263596, 0x263796, 0x253996, 0x253B96, 0x253E96, 0x244096, 0x244296, 0x234496, 0x234696,
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    0xFFF2D5, 0xFFF4D6, 0xFFF6D8, 0xFFF8DA,
  },

  // ARCTIC
  { 0x3C96, 0x3E97, 0x13F98, 0x24198, 0x34399, 0x4449A, 0x5469B, 0x6479C, 0x7499D, 0x84B9D, 0x94C9E,
    0xA4E9F, 0xB50A0, 0xC51A1, 0xD53A1, 0xE54A2, 0xF56A3, 0x1058A4, 0x1159A5, 0x125BA5, 0x135DA6, 0x145EA7,
    0x1560A8, 0x1661A9, 0x1763AA, 0x1865AA, 0x1966AB, 0x1968AC, 0x1A6AAD, 0x1B6BAE, 0x1C6DAE, 0x1D6EAF, 0x1E70B0,
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    0xFAF0A6, 0xFAF0A7, 0xFAF0A8, 0xFAF0A9,
  },

  //OUTDOOR_ALERT
  { 0xF5F5F5, 0xF4F4F4, 0xF3F3F3, 0xF2F2F2, 0xF1F1F1, 0xF1F1F1, 0xF0F0F0, 0xEFEFEF, 0xEEEEEE, 0xEEEEEE, 0xEDEDED,
    0xECECEC, 0xEBEBEB, 0xEBEBEB, 0xEAEAEA, 0xE9E9E9, 0xE8E8E8, 0xE8E8E8, 0xE7E7E7, 0xE6E6E6, 0xE5E5E5, 0xE5E5E5,
    0xE4E4E4, 0xE3E3E3, 0xE2E2E2, 0xE2E2E2, 0xE1E1E1, 0xE0E0E0, 0xDFDFDF, 0xDFDFDF, 0xDEDEDE, 0xDDDDDD, 0xDCDCDC,
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    0xFFF0BB, 0xFFF3C3, 0xFFF6CA, 0xFFF9D2,
  },

  //WHITE_HOT
  { 0xA0A0A,  0xA0A0A,  0xA0A0A,  0xA0A0A,  0xA0A0A,  0xA0A0A,  0xA0A0A,  0xA0A0A,  0xA0A0A,  0xA0A0A,  0xA0A0A,
    0xA0A0A,  0xA0A0A,  0xA0A0A,  0xA0A0A,  0xA0A0A,  0xA0A0A,  0xA0A0A,  0xA0A0A,  0xA0A0A,  0xA0A0A,  0xB0B0B,
    0xB0B0B,  0xC0C0C,  0xD0D0D,  0xD0D0D,  0xE0E0E,  0xE0E0E,  0xF0F0F,  0xF0F0F,  0x101010, 0x101010, 0x111111,
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    0xE8E8E8, 0xE9E9E9, 0xE9E9E9, 0xEAEAEA,
  },

  //BLACK_HOT
  { 0xEBEBEB, 0xEAEAEA, 0xE9E9E9, 0xE9E9E9, 0xE8E8E8, 0xE8E8E8, 0xE7E7E7, 0xE7E7E7, 0xE6E6E6, 0xE6E6E6, 0xE5E5E5,
    0xE5E5E5, 0xE4E4E4, 0xE3E3E3, 0xE3E3E3, 0xE2E2E2, 0xE2E2E2, 0xE1E1E1, 0xE1E1E1, 0xE0E0E0, 0xE0E0E0, 0xDFDFDF,
    0xDFDFDF, 0xDEDEDE, 0xDDDDDD, 0xDDDDDD, 0xDCDCDC, 0xDCDCDC, 0xDBDBDB, 0xDBDBDB, 0xDADADA, 0xDADADA, 0xD9D9D9,
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    0xA0A0A, 0xA0A0A, 0xA0A0A, 0xA0A0A,
  }


};





// Save some element references for direct access
//<Save_References !Start!>
gslc_tsElemRef* ambTempTxt        = NULL;
gslc_tsElemRef* autoBtn           = NULL;
gslc_tsElemRef* autoScaleScrl     = NULL;
gslc_tsElemRef* autoScaleTxt      = NULL;
gslc_tsElemRef* avFrontTxt        = NULL;
gslc_tsElemRef* avLeftTxt         = NULL;
gslc_tsElemRef* avRearTxt         = NULL;
gslc_tsElemRef* avRightTxt        = NULL;
gslc_tsElemRef* backspaceBtn      = NULL;
gslc_tsElemRef* colorBackBtn      = NULL;
gslc_tsElemRef* colorList         = NULL;
gslc_tsElemRef* colorListScrl     = NULL;
gslc_tsElemRef* colorSelectBtn    = NULL;
gslc_tsElemRef* cursorBtn         = NULL;
gslc_tsElemRef* cursorOnTxt       = NULL;
gslc_tsElemRef* cursorTxt         = NULL;
gslc_tsElemRef* dataTxt_1         = NULL;
gslc_tsElemRef* dataTxt_10        = NULL;
gslc_tsElemRef* dataTxt_11        = NULL;
gslc_tsElemRef* dataTxt_12        = NULL;
gslc_tsElemRef* dataTxt_2         = NULL;
gslc_tsElemRef* dataTxt_3         = NULL;
gslc_tsElemRef* dataTxt_4         = NULL;
gslc_tsElemRef* dataTxt_5         = NULL;
gslc_tsElemRef* dataTxt_6         = NULL;
gslc_tsElemRef* dataTxt_7         = NULL;
gslc_tsElemRef* dataTxt_8         = NULL;
gslc_tsElemRef* dataTxt_9         = NULL;
gslc_tsElemRef* dateTimeTxt       = NULL;
gslc_tsElemRef* dateTxt           = NULL;
gslc_tsElemRef* defaultBtn        = NULL;
gslc_tsElemRef* deleteBtn         = NULL;
gslc_tsElemRef* deltaFLTxt        = NULL;
gslc_tsElemRef* deltaFRTxt        = NULL;
gslc_tsElemRef* deltaRLTxt        = NULL;
gslc_tsElemRef* deltaRRTxt        = NULL;
gslc_tsElemRef* frontLeft         = NULL;
gslc_tsElemRef* frontRight        = NULL;
gslc_tsElemRef* homeBtn           = NULL;
gslc_tsElemRef* logAmbTxt         = NULL;
gslc_tsElemRef* logBackBtn        = NULL;
gslc_tsElemRef* logDeleteNo       = NULL;
gslc_tsElemRef* logDeleteYes      = NULL;
gslc_tsElemRef* logList           = NULL;
gslc_tsElemRef* logLoadBtn        = NULL;
gslc_tsElemRef* logNameDateTxt    = NULL;
gslc_tsElemRef* logSaveBtn        = NULL;
gslc_tsElemRef* logScrl           = NULL;
gslc_tsElemRef* logTempTxt        = NULL;
gslc_tsElemRef* logTrackTxt       = NULL;
gslc_tsElemRef* maxTempBtn        = NULL;
gslc_tsElemRef* minTempBtn        = NULL;
gslc_tsElemRef* okBtn             = NULL;
gslc_tsElemRef* pgLogBtn          = NULL;
gslc_tsElemRef* pgPressBtn        = NULL;
gslc_tsElemRef* pgTempBtn         = NULL;
gslc_tsElemRef* pgThermalBtn      = NULL;
gslc_tsElemRef* pressGauge        = NULL;
gslc_tsElemRef* pressPauseBtn     = NULL;
gslc_tsElemRef* profileList       = NULL;
gslc_tsElemRef* profileScrl       = NULL;
gslc_tsElemRef* rearLeft          = NULL;
gslc_tsElemRef* rearRight         = NULL;
gslc_tsElemRef* resSCRL           = NULL;
gslc_tsElemRef* resTxt            = NULL;
gslc_tsElemRef* saveLoadBtn       = NULL;
gslc_tsElemRef* saveLoadProgBox   = NULL;
gslc_tsElemRef* saveLoadProgress  = NULL;
gslc_tsElemRef* tempGauge         = NULL;
gslc_tsElemRef* tempPauseBtn      = NULL;
gslc_tsElemRef* thermalPauseBtn   = NULL;
gslc_tsElemRef* thermalSettBtn    = NULL;
gslc_tsElemRef* timeTxt           = NULL;
gslc_tsElemRef* trackTempBtn      = NULL;
gslc_tsElemRef* trackTempTxt      = NULL;
gslc_tsElemRef* wakeBtn           = NULL;
gslc_tsElemRef* m_pElemKeyPadNum  = NULL;
//<Save_References !End!>

// Define debug message function
static int16_t DebugOut(char ch) {
  if (ch == (char)'\n') Serial.println("");
  else Serial.write(ch);
  return 0;
}

// ------------------------------------------------
// Callback Methods
// ------------------------------------------------
// Common Button callback
bool CbBtnCommon(void* pvGui, void *pvElemRef, gslc_teTouch eTouch, int16_t nX, int16_t nY)
{
  // Typecast the parameters to match the GUI and element types
  gslc_tsGui*     pGui     = (gslc_tsGui*)(pvGui);
  gslc_tsElemRef* pElemRef = (gslc_tsElemRef*)(pvElemRef);
  gslc_tsElem*    pElem    = gslc_GetElemFromRef(pGui, pElemRef);


  if ( eTouch == GSLC_TOUCH_UP_IN ) {
    screensaverTimer = currentMillis;
    // From the element's ID we can determine which button was pressed.
    switch (pElem->nId) {
//<Button Enums !Start!>
      case HOME_BTN:
        gslc_SetPageCur(&m_gui, PG_Home);
        break;
      case WAKE_BTN:
        gslc_SetPageCur(&m_gui, lastPageId);
        break;
      case PG_PRESS_BTN:
        gslc_SetPageCur(&m_gui, PG_Pressure);
        break;
      case PG_TEMP_BTN:
        gslc_SetPageCur(&m_gui, PG_Temp);
        break;
      case PG_THERMAL_BTN:
        gslc_SetPageCur(&m_gui, PG_Thermal);
        break;
      case PG_LOG_BTN:
        gslc_SetPageCur(&m_gui, PG_Log);
        break;
      case PRESS_PAUSE_BTN:
        if (pausePressure == false) {
          pausePressure = true;
        }
        else {
          pausePressure = false;
        }
        gslc_ElemSetRedraw(&m_gui, pressPauseBtn, GSLC_REDRAW_FULL);
        break;
      case TEMP_PAUSE_BTN:
        if (pauseTemp == false) {
          pauseTemp = true;
        }
        else {
          pauseTemp = false;
        }
        gslc_ElemSetRedraw(&m_gui, tempPauseBtn, GSLC_REDRAW_FULL);
        break;
      case AUTO_BTN:
        if (autoScale == false) {
          DefaultTemp = false;
          autoScale = true;
        }
        else {
          autoScale = false;
        }
        gslc_ElemSetRedraw(&m_gui, autoBtn, GSLC_REDRAW_FULL);
        break;
      case THERMAL_PAUSE_BTN:
        if (pauseThermal == false) {
          pauseThermal = true;
        }
        else {
          pauseThermal = false;
        }
        gslc_ElemSetRedraw(&m_gui, thermalPauseBtn, GSLC_REDRAW_FULL);
        break;
      case MIN_TEMP_BTN:
        pauseThermal = true;
        // Clicked on edit field, so show popup box and associate with this text field
        gslc_ElemXKeyPadInputAsk(&m_gui, m_pElemKeyPadNum, E_POP_KEYPAD_NUM, minTempBtn);
        break;
      case DEFAULT_BTN:
        autoScale = false ;
        DefaultTemp = true;
        SetTempScale();
        gslc_ElemSetRedraw(&m_gui, autoBtn, GSLC_REDRAW_FULL);
        break;
      case MAX_TEMP_BTN:
        pauseThermal = true;
        // Clicked on edit field, so show popup box and associate with this text field
        gslc_ElemXKeyPadInputAsk(&m_gui, m_pElemKeyPadNum, E_POP_KEYPAD_NUM, maxTempBtn);
        break;
      case THERMAL_SETT_BTN:
        pauseThermal = true;
        gslc_PopupShow(&m_gui, THERMAL_SETTINGS, true);
        break;
      case TRACK_TEMP_BTN:
        snprintf(trackTempBuf, MAX_STR, "Track Temp:%.0f'C", cursorTemp);
        gslc_ElemSetTxtStr(&m_gui, trackTempTxt , trackTempBuf);
        break;
      case FRONT_LEFT:
        SetWheelPos(FrontLeft);
        break;
      case FRONT_RIGHT:
        SetWheelPos(FrontRight);
        break;
      case REAR_LEFT:
        SetWheelPos(RearLeft);
        break;
      case REAR_RIGHT:
        SetWheelPos(RearRight);
        break;
      case OK_BTN:
        counter ++;
        SaveMeasurement (counter);
        ShowStats (counter);
        ShowLogInfo (false);
        if (counter >= 11) {
          counter = -1;
        }
        break;
      case BACKSPACE_BTN:
        if (counter >= 0) {
          DeleteMeasurement (counter);
          counter --;
        }
        ShowLogInfo (false);
        break;
      case DELETE_BTN:
        gslc_PopupShow(&m_gui, CONFIRM_DELETE, true);
        break;
      case SAVE_LOAD_BTN:
        gslc_PopupShow(&m_gui, LOG_SAVE_LOAD, true);
        break;
      case CURSOR_BTN:
        // TODO Add code for Toggle button ON/OFF state
        if (gslc_ElemXTogglebtnGetState(&m_gui, cursorBtn)) {
          cursorOn = true;
          gslc_ElemSetTxtStr(&m_gui, cursorOnTxt , "On");
        }
        else {
          cursorOn = false;
          gslc_ElemSetTxtStr(&m_gui, cursorOnTxt , "Off");
        }
        break;
      case COLOR_BACK_BTN:
        gslc_PopupHide(&m_gui);
        pauseThermal = false;
        break;
      case COLOR_SELECT_BTN:
        gslc_PopupHide(&m_gui);
        thermalCol = thermalSel;
        pauseThermal = false;
        break;
      case LOG_SAVE_BTN:
        if (strcmp (logFolder, "") != 0 && strcmp (logFolder, "") != 0) {
          snprintf(logPath, MAX_STR, "/%s/%s.txt", logFolder, logName);
          saveLogFile(SD, logPath);
        }
        break;
      case LOG_LOAD_BTN:
        if (strcmp (logFolder, "") != 0 && strcmp (logFolder, "") != 0) {
          snprintf(logPath, MAX_STR, "/%s/%s.txt", logFolder, logName);
          openLogFile (SD, logPath);
          ShowLogInfo (true);
        }
        break;
      case LOG_BACK_BTN:
        ShowFileProgress(0);
        gslc_PopupHide(&m_gui);
        break;
      case LOG_DEL_YES:
        ResetLog();
        ShowLogInfo (false);
        gslc_PopupHide(&m_gui);
        break;
      case LOG_DEL_NO:
        gslc_PopupHide(&m_gui);
        break;
//<Button Enums !End!>
      default:
        break;
    }
  }
  return true;
}
//<Checkbox Callback !Start!>
//<Checkbox Callback !End!>
// KeyPad Input Ready callback
bool CbKeypad(void* pvGui, void *pvElemRef, int16_t nState, void* pvData)
{
  gslc_tsGui*     pGui     = (gslc_tsGui*)pvGui;
  gslc_tsElemRef* pElemRef = (gslc_tsElemRef*)(pvElemRef);
  gslc_tsElem*    pElem    = gslc_GetElemFromRef(pGui, pElemRef);

  // From the pvData we can get the ID element that is ready.
  int16_t nTargetElemId = gslc_ElemXKeyPadDataTargetIdGet(pGui, pvData);
  if (nState == XKEYPAD_CB_STATE_DONE) {
    // User clicked on Enter to leave popup
    // - If we have a popup active, pass the return value directly to
    //   the corresponding value field
    switch (nTargetElemId) {
//<Keypad Enums !Start!>

      case MIN_TEMP_BTN:
        gslc_ElemXKeyPadInputGet(pGui, minTempBtn, pvData);
        pauseThermal = false;
        MINTEMP = atoi (gslc_ElemGetTxtStr (pGui, minTempBtn)) ;
        gslc_PopupHide(&m_gui);

        break;
      case MAX_TEMP_BTN:
        gslc_ElemXKeyPadInputGet(pGui, maxTempBtn, pvData);
        MAXTEMP = atoi (gslc_ElemGetTxtStr (pGui, maxTempBtn)) ;
        gslc_PopupHide(&m_gui);
        pauseThermal = false;
        break;
//<Keypad Enums !End!>
      default:
        break;
    }
  } else if (nState == XKEYPAD_CB_STATE_CANCEL) {
    // User escaped from popup, so don't update values
    gslc_PopupHide(&m_gui);
    pauseThermal = false;
  }
  return true;
}
//<Spinner Callback !Start!>
//<Spinner Callback !End!>
bool CbListbox(void* pvGui, void* pvElemRef, int16_t nSelId)
{
  gslc_tsGui*     pGui     = (gslc_tsGui*)(pvGui);
  gslc_tsElemRef* pElemRef = (gslc_tsElemRef*)(pvElemRef);
  gslc_tsElem*    pElem    = gslc_GetElemFromRef(pGui, pElemRef);
  char            acTxt[MAX_STR + 1];

  if (pElemRef == NULL) {
    return false;
  }

  // From the element's ID we can determine which listbox was active.
  switch (pElem->nId) {
//<Listbox Enums !Start!>

    case COLOR_LIST:
      if (nSelId != XLISTBOX_SEL_NONE) {
        gslc_ElemXListboxGetItem(&m_gui, pElemRef, nSelId, acTxt, MAX_STR);
      }
      thermalSel = nSelId;
      SetColorPreview(147, 112, 16, thermalSel);
      break;
    case PROFILE_LIST:
      if (nSelId != XLISTBOX_SEL_NONE) {
        gslc_ElemXListboxGetItem(&m_gui, pElemRef, nSelId, logFolder, MAX_STR);
      }
      break;
    case LOG_LIST:
      if (nSelId != XLISTBOX_SEL_NONE) {
        gslc_ElemXListboxGetItem(&m_gui, pElemRef, nSelId, logName, MAX_STR);
      }
      break;
//<Listbox Enums !End!>
    default:
      break;
  }
  return true;
}
// Scanner drawing callback function
// - This is called when E_ELEM_SCAN is being rendered
bool CbDrawScanner(void* pvGui, void* pvElemRef, gslc_teRedrawType eRedraw)
{
  int nInd;


  // Typecast the parameters to match the GUI and element types
  gslc_tsGui*     pGui     = (gslc_tsGui*)(pvGui);
  gslc_tsElemRef* pElemRef = (gslc_tsElemRef*)(pvElemRef);
  gslc_tsElem*    pElem    = gslc_GetElemFromRef(pGui, pElemRef);


  // Create shorthand variables for the origin
  int16_t  nX = pElem->rElem.x;
  int16_t  nY = pElem->rElem.y;
  // Draw the background
  gslc_tsRect rInside = pElem->rElem;
  rInside = gslc_ExpandRect(rInside, 0, 0);
  gslc_DrvDrawFillRoundRect (pGui, rInside, 5, pElem->colElemFill);
  // Enable localized clipping
  gslc_SetClipRect(pGui, &rInside);

  //TODO - Add your drawing graphic primitives
  if (pElemRef == pressPauseBtn) {
    if (pausePressure == false) {
      gslc_DrvDrawBmp24FromSD(&m_gui, "/pause.bmp", rInside.x, rInside.y);
    } else {
      gslc_DrvDrawBmp24FromSD(&m_gui, "/play.bmp", rInside.x, rInside.y);
    }
  }

  if (pElemRef == tempPauseBtn) {
    if (pauseTemp == false) {
      gslc_DrvDrawBmp24FromSD(&m_gui, "/pause.bmp", rInside.x, rInside.y);
    } else {
      gslc_DrvDrawBmp24FromSD(&m_gui, "/play.bmp", rInside.x, rInside.y);
    }
  }

  if (pElemRef == thermalPauseBtn) {
    if (pauseThermal == false) {
      gslc_DrvDrawBmp24FromSD(&m_gui, "/pause.bmp", rInside.x, rInside.y);
    } else {
      gslc_DrvDrawBmp24FromSD(&m_gui, "/play.bmp", rInside.x, rInside.y);
    }
  }

  if (pElemRef == autoBtn) {
    if (autoScale == false) {
      gslc_DrvDrawBmp24FromSD(&m_gui, "/autoInactive.bmp", rInside.x, rInside.y);
    } else {
      gslc_DrvDrawBmp24FromSD(&m_gui, "/autoActive.bmp", rInside.x, rInside.y);
    }
  }

  if (pElemRef == defaultBtn) {
    SetColorPreview (112, 210, 20, thermalCol);
  }
  if (pElemRef == frontLeft) {
    GetTireColor ( FrontLeft, dataFieldInt[2], dataFieldInt[1], dataFieldInt[0]);
  }
  if (pElemRef == rearLeft) {
    GetTireColor ( RearLeft, dataFieldInt[5], dataFieldInt[4], dataFieldInt[3]);
  }
  if (pElemRef == rearRight) {
    GetTireColor ( RearRight, dataFieldInt[6], dataFieldInt[7], dataFieldInt[8]);
  }
  if (pElemRef == frontRight) {
    GetTireColor ( FrontRight, dataFieldInt[9], dataFieldInt[10], dataFieldInt[11]);
  }
  // Disable clipping region
  gslc_SetClipRect(pGui, NULL);

  // Draw the frame
  gslc_DrawFrameRoundRect(pGui, pElem->rElem, 5, pElem->colElemFrame);

  // Clear the redraw flag
  gslc_ElemSetRedraw(&m_gui, pElemRef, GSLC_REDRAW_NONE);

  return true;
}

// Callback function for when a slider's position has been updated
bool CbSlidePos(void* pvGui, void* pvElemRef, int16_t nPos)
{
  gslc_tsGui*     pGui     = (gslc_tsGui*)(pvGui);
  gslc_tsElemRef* pElemRef = (gslc_tsElemRef*)(pvElemRef);
  gslc_tsElem*    pElem    = gslc_GetElemFromRef(pGui, pElemRef);
  int16_t         nVal;
  gslc_tsElemRef* pElemRefTmp = NULL;

  // From the element's ID we can determine which slider was updated.
  switch (pElem->nId) {
//<Slider Enums !Start!>

    case COLOR_LIST_SCRL:
      // Fetch the slider position
      nVal = gslc_ElemXSliderGetPos(pGui, colorListScrl);
      // Update the textbox scroll position
      pElemRefTmp = gslc_PageFindElemById(pGui, THERMAL_SETTINGS, COLOR_LIST);
      gslc_ElemXListboxSetScrollPos(pGui, pElemRefTmp, nVal);
      break;
    case AUTO_SCALE_SCRL:
      // Fetch the slider position
      nVal = gslc_ElemXSliderGetPos(pGui, autoScaleScrl);
      scaleRange = nVal;
      snprintf(scaleRangeBuf, 2, "%i", nVal);
      gslc_ElemSetTxtStr(&m_gui, autoScaleTxt , scaleRangeBuf);
      break;
    case PROFILE_SCRL:
      // Fetch the slider position
      nVal = gslc_ElemXSliderGetPos(pGui, profileScrl);
      pElemRefTmp = gslc_PageFindElemById(pGui, LOG_SAVE_LOAD, PROFILE_LIST);
      gslc_ElemXListboxSetScrollPos(pGui, pElemRefTmp, nVal);
      break;
    case LOG_SCRL:
      // Fetch the slider position
      nVal = gslc_ElemXSliderGetPos(pGui, logScrl);
      pElemRefTmp = gslc_PageFindElemById(pGui, LOG_SAVE_LOAD, LOG_LIST);
      gslc_ElemXListboxSetScrollPos(pGui, pElemRefTmp, nVal);
      break;
    case RES_SCRL:
      // Fetch the slider position
      nVal = gslc_ElemXSliderGetPos(pGui, resSCRL);
      SetResolution(nVal);
      break;
//<Slider Enums !End!>
    default:
      break;
  }

  return true;
}
//<Tick Callback !Start!>
//<Tick Callback !End!>

void setup()
{
  // ------------------------------------------------
  // Initialize
  // ------------------------------------------------
  Serial.begin(9600);
  // Wait for USB Serial
  //delay(1000);  // NOTE: Some devices require a delay after Serial.begin() before serial port can be used

  gslc_InitDebug(&DebugOut);
  amg.begin();
  probe.begin();
  rtc.begin();
  //rtc.adjust(DateTime(F(__DATE__), F(__TIME__)));
  refreshTimer = millis();
  screensaverTimer = millis();


  // ------------------------------------------------
  // Create graphic elements
  // ------------------------------------------------

  InitGUIslice_gen();
  gslc_ElemSetGlowEn(&m_gui, dataTxt_1, true);
  gslc_ElemSetGlowEn(&m_gui, dataTxt_2, true);
  gslc_ElemSetGlowEn(&m_gui, dataTxt_3, true);
  gslc_ElemSetGlowEn(&m_gui, dataTxt_4, true);
  gslc_ElemSetGlowEn(&m_gui, dataTxt_5, true);
  gslc_ElemSetGlowEn(&m_gui, dataTxt_6, true);
  gslc_ElemSetGlowEn(&m_gui, dataTxt_7, true);
  gslc_ElemSetGlowEn(&m_gui, dataTxt_8, true);
  gslc_ElemSetGlowEn(&m_gui, dataTxt_9, true);
  gslc_ElemSetGlowEn(&m_gui, dataTxt_10, true);
  gslc_ElemSetGlowEn(&m_gui, dataTxt_11, true);
  gslc_ElemSetGlowEn(&m_gui, dataTxt_12, true);
  gslc_ElemSetGlow(&m_gui, dataTxt_1, true);
  gslc_ElemSetVisible(&m_gui, logNameDateTxt, false);
  gslc_ElemSetVisible(&m_gui, logAmbTxt, false);
  gslc_ElemSetVisible(&m_gui, logTrackTxt, false);
}

// -----------------------------------
// Main event loop
// -----------------------------------
void loop()
{
  // ------------------------------------------------
  // General
  // ------------------------------------------------
  
  currentMillis = millis();
  DateTime now = rtc.now();

  // ------------------------------------------------
  // Update Base Page Headers
  // ------------------------------------------------


  if (gslc_GetPageCur(&m_gui) == PG_ScreenSaver) {
    char Time [] = "hh:mm";
    gslc_ElemSetTxtStr(&m_gui, timeTxt, (now.toString(Time)));
    char Date [] = "DDD, DD/MM/YYYY";
    gslc_ElemSetTxtStr(&m_gui, dateTxt, (now.toString(Date)));
  }
  else {
    ambTemp = amg.readThermistor();
    if (ambTemp != -127) {
      snprintf(ambTempBuf, MAX_STR, "Amb Temp:%d'C", ambTemp);
      gslc_ElemSetTxtStr(&m_gui, ambTempTxt, ambTempBuf);
    }
    char dateTime[] = "DDD, DD/MM/YYYY hh:mm";
    gslc_ElemSetTxtStr(&m_gui, dateTimeTxt, (now.toString(dateTime)));
    if (currentMillis - screensaverTimer >= 1 * Minutes) {
      lastPageId = gslc_GetPageCur(&m_gui) ;
      gslc_PopupHide(&m_gui);
      gslc_SetPageCur(&m_gui, PG_ScreenSaver);
    }
  }


  // ------------------------------------------------
  // Update GUI Elements
  // ------------------------------------------------

  if (gslc_GetPageCur(&m_gui) == PG_Pressure && pausePressure == false) {
    if (currentMillis - refreshTimer >= 1 * Halfseconds) {
      GetPressure();
      snprintf(pressureBuf, MAX_STR, "%.3f", gaugePressure);
      gslc_ElemSetTxtStr(&m_gui, pressGauge, pressureBuf);
      gslc_ElemXRingGaugeSetVal(&m_gui, pressGauge, gaugeVal);
      refreshTimer = currentMillis;
    }
  }

   if (gslc_GetPageCur(&m_gui) == PG_Temp && pauseTemp == false) {
    if (currentMillis - refreshTimer >= 1 * Halfseconds) {
      GetTemperature();
      snprintf(tempBuf, MAX_STR, "%.2f'C", probeTemp);
      gslc_ElemSetTxtStr(&m_gui, tempGauge, tempBuf);
      gslc_ElemXRingGaugeSetVal(&m_gui, tempGauge, gaugeVal);
      refreshTimer = currentMillis;
    }
  }


  if (gslc_GetPageCur(&m_gui) == PG_Log) {
    if (isnan(probeTemp)) {
      if ((gslc_ElemGetVisible(&m_gui, logTempTxt) == true)) {
        gslc_ElemSetVisible(&m_gui, logTempTxt, false);
      }
    }
    else {
      if (gslc_ElemGetVisible(&m_gui, logTempTxt) == false) {
        gslc_ElemSetVisible(&m_gui, logTempTxt, true);
      }
      if (currentMillis - refreshTimer >= 1 * Halfseconds) {
        GetTemperature();
        snprintf(tempBuf, MAX_STR, "%.2f'C", probeTemp);
        gslc_ElemSetTxtStr(&m_gui, logTempTxt, tempBuf);
        refreshTimer = currentMillis;
      }
    }
  }



  if (gslc_GetPageCur(&m_gui) == PG_Thermal && pauseThermal == false) {
      amg.readPixels(pixels);
      interpolate_image(pixels, AMG_ROWS, AMG_COLS, dest_2d, INTERPOLATED_ROWS, INTERPOLATED_COLS);
      drawpixels(dest_2d, INTERPOLATED_ROWS, INTERPOLATED_COLS, boxWidth, boxHeight, false);
  }


  // ------------------------------------------------
  // Periodically call GUIslice update function
  // ------------------------------------------------
  gslc_Update(&m_gui);

}


// ----------------------------------------------------------------------------------------------------
// Thermal Camera Functions
// ----------------------------------------------------------------------------------------------------
void drawpixels(float * p, uint8_t rows, uint8_t cols, uint8_t boxWidth, uint8_t boxHeight, boolean showVal) { //From Adafruit example
  for (int y = 0; y < rows; y++) {
    for (int x = 0; x < cols; x++) {
      float val = get_point(p, rows, cols, x, y);
      if (val >= MAXTEMP) colorTemp = MAXTEMP;
      else if (val <= MINTEMP) colorTemp = MINTEMP;
      else colorTemp = val;
      uint16_t colorIndex = map(colorTemp * 1000, MINTEMP * 1000, MAXTEMP * 1000, 0, 432);
      colorIndex = constrain(colorIndex, 0, 432);
      gslc_tsRect rCamRect = {
        60 + boxWidth * x,
        20 + boxHeight * y,
        boxWidth,
        boxHeight
      };
      uint32_t     nCamColor_HEX = colorPallete [thermalCol] [colorIndex];
      gslc_tsColor nCamCol_rgb;
      nCamCol_rgb.r = ((nCamColor_HEX >> 16) & 0xFF);
      nCamCol_rgb.g = ((nCamColor_HEX >> 8) & 0xFF);
      nCamCol_rgb.b = ((nCamColor_HEX) & 0xFF) ;
      gslc_DrvDrawFillRect(&m_gui, rCamRect, nCamCol_rgb);
    }
    if (cursorOn == true) {
      SetCursor ();
    }
  }
  if (autoScale == true) {
    SetTempScale();
  }

}

void SetTempScale() {
  if (DefaultTemp == true) {
    MINTEMP = 20;
    MAXTEMP = 30;
  }
  else {
    float val = 0.0;
    for (int i = 0; i < 64; i++) {
      val = val + pixels[i];
    }
    val = val / 64.0;
    MINTEMP = val - scaleRange;
    MAXTEMP = val + scaleRange;
    snprintf(minTempBuf, 3, "%d", MINTEMP);
    gslc_ElemSetTxtStr(&m_gui, minTempBtn  , minTempBuf);
    snprintf(maxTempBuf, 3, "%d", MAXTEMP);
    gslc_ElemSetTxtStr(&m_gui, maxTempBtn, maxTempBuf);
  }
}

void SetColorPreview (int preview_x, int preview_y, int preview_h, int pallete ) {
  if ((pallete < 0) | (pallete > 6) ) {
    for (int j = 0; j < 150; j++) {
      gslc_DrawLineV (&m_gui, preview_x + j, preview_y, preview_h, GSLC_COL_WHITE);
    }
  }
  else {
    for (int j = 0; j < 150; j++) {
      colorMap = map (j, 0, 150, 0, 432);
      uint32_t     nColorMap_HEX = colorPallete [pallete] [colorMap];
      gslc_tsColor nColorMap_rgb;
      nColorMap_rgb.r = ((nColorMap_HEX >> 16) & 0xFF);
      nColorMap_rgb.g = ((nColorMap_HEX >> 8) & 0xFF);
      nColorMap_rgb.b = ((nColorMap_HEX) & 0xFF) ;
      gslc_DrawLineV (&m_gui, preview_x + j, preview_y, preview_h, nColorMap_rgb);
    }
  }
}

void SetResolution (int resolution) {
  if (resolution == 0) {      //Low Resolution
    gslc_ElemSetTxtStr(&m_gui, resTxt , "Low");
    INTERPOLATED_COLS = 18;
    INTERPOLATED_ROWS = 15;
    boxWidth = 14;
    boxHeight = 12;
  }
  else if (resolution == 1) { //Medium Resolution
    gslc_ElemSetTxtStr(&m_gui, resTxt , "Medium");
    INTERPOLATED_COLS = 36;
    INTERPOLATED_ROWS = 36;
    boxWidth = 7;
    boxHeight = 5;
  }
  else if (resolution == 2) { //High Resolution
    gslc_ElemSetTxtStr(&m_gui, resTxt , "High");
    INTERPOLATED_COLS = 63;
    INTERPOLATED_ROWS = 60;
    boxWidth =  4;
    boxHeight = 3;
  }
}

void SetCursor () {
  cursorTemp = (pixels [28] + pixels [29] + pixels [36] + pixels [37]) / 4;
  snprintf(cursorTempBuf, 7, "%.2f", cursorTemp);
  for (int j = 0; j < 3; j++) {
    gslc_DrawLineH (&m_gui, 171, 109 + j, 30, GSLC_COL_WHITE);
    gslc_DrawLineV (&m_gui, 185 + j, 95, 30, GSLC_COL_WHITE);
  }
  gslc_ElemSetTxtStr(&m_gui, cursorTxt , cursorTempBuf);
}



// ---------------------------------------------------------------------------------------
// Data Log Functions
// ---------------------------------------------------------------------------------------
void GetTireColor (uint8_t wheelPos, int16_t outside, int16_t middle, int16_t inside) {
  unsigned int tireColor;
  int tire_x;
  int tire_y;
  int i = 4;
  int n = 4;
  int insideTempCol = map (constrain (inside / 100, 15, 120), 15, 120, 0, 432);
  int middleTempCol = map (constrain (middle / 100, 15, 120), 15, 120, 0, 432);
  int outsideTempCol = map (constrain (outside / 100, 15, 120), 15, 120, 0, 432);
  switch (wheelPos) {
    case FrontLeft:
      tire_x = 120;
      tire_y = 40;
      break;
    case RearLeft:
      tire_x = 120;
      tire_y = 170;
      break;
    case RearRight:
      tire_x = 220;
      tire_y = 170;
      break;
    case FrontRight:
      tire_x = 220;
      tire_y = 40;
      break;
  }
  for (int j = 0; j < 30; j++) {
    if (j <= 5) {
      tireColor = outsideTempCol;
    }
    else if ((j >= 6) & (j <= 11)) {
      tireColor = outsideTempCol + ((middleTempCol - outsideTempCol) / 6) * (j - 6) ;
    }
    else if ((j >= 12) & (j <= 17)) {
      tireColor = middleTempCol;
    }
    else if ((j >= 18) & (j <= 23)) {
      tireColor = middleTempCol + ((insideTempCol - middleTempCol) / 6) * (j - 17) ;
    }
    else if (j >= 24) {
      tireColor = insideTempCol;
    }
    uint32_t nTireColor_HEX = colorPallete [1] [tireColor];
    gslc_tsColor nTireColor_rgb;
    nTireColor_rgb.r = ((nTireColor_HEX >> 16) & 0xFF);
    nTireColor_rgb.g = ((nTireColor_HEX >> 8) & 0xFF);
    nTireColor_rgb.b = ((nTireColor_HEX) & 0xFF) ;
    gslc_DrawLineV (&m_gui, tire_x + j , tire_y + i , 50 - (i * 2), nTireColor_rgb);
    if (j < 4) {
      i --;
    }
    else if (j >= 25) {
      i++;
    }
  }
}

void SetTireColor() {
  gslc_tsElemRef* Tire[] = {
    frontLeft,
    frontRight,
    rearLeft,
    rearRight,
  };
  for (uint8_t i = 0; i < 4; i++) {
    gslc_ElemSetRedraw(&m_gui, Tire[i], GSLC_REDRAW_FULL);
  }
}

void openLogFile(fs::FS & fs, const char * path) {
  gslc_tsElemRef* dataField[] = {
    dataTxt_1,
    dataTxt_2,
    dataTxt_3,
    dataTxt_4,
    dataTxt_5,
    dataTxt_6,
    dataTxt_7,
    dataTxt_8,
    dataTxt_9,
    dataTxt_10,
    dataTxt_11,
    dataTxt_12,
    logAmbTxt,
    logTrackTxt,
  };
  ResetLog();
  File file = fs.open(path);
  while (file.available()) {
    for (int i = 0; i < numberLogLines; i++) {
      String list = file.readStringUntil('\n');

      if (i < 14) {
        const char* listConv = list.c_str();
        gslc_ElemSetTxtStr(&m_gui, (dataField[i]) , listConv);
      }
      else {
        dateBuf = list.c_str();
      }
      delay(50);
      ShowFileProgress (i);
    }
    file.close();

  }
  snprintf(LogInfoBuf, MAX_STR, "%s, %s: %s", logFolder, logName, dateBuf);
  gslc_ElemSetTxtStr(&m_gui, logNameDateTxt, LogInfoBuf);
  dataConvertToInt ();
  ShowStats (12);
}

void saveLogFile (fs::FS & fs, const char * path) {
  gslc_tsElemRef* dataField[] = {
    dataTxt_1,
    dataTxt_2,
    dataTxt_3,
    dataTxt_4,
    dataTxt_5,
    dataTxt_6,
    dataTxt_7,
    dataTxt_8,
    dataTxt_9,
    dataTxt_10,
    dataTxt_11,
    dataTxt_12,
    ambTempTxt,
    trackTempTxt,
    dateTimeTxt
  };
  fs.remove(path);
  File file = fs.open(path, FILE_WRITE);
  for (int i = 0; i < numberLogLines; i++) {
    file.print(gslc_ElemGetTxtStr(&m_gui, (dataField[i])));
    file.print("\n");
    delay(50);
    ShowFileProgress (i);
  }
  file.close();
}

void ShowFileProgress (uint8_t progress) {
  gslc_ElemXProgressSetVal(&m_gui, saveLoadProgress, progress);
  gslc_Update(&m_gui);
}

void ShowLogInfo (bool loadLogInfo) {
  if (loadLogInfo == true) {
    gslc_ElemSetVisible(&m_gui, logNameDateTxt, true);
    gslc_ElemSetVisible(&m_gui, logAmbTxt, true);
    gslc_ElemSetVisible(&m_gui, logTrackTxt, true);
  }
  else {
    gslc_ElemSetVisible(&m_gui, logNameDateTxt, false);
    gslc_ElemSetVisible(&m_gui, logAmbTxt, false);
    gslc_ElemSetVisible(&m_gui, logTrackTxt, false);
  }
}

void SaveMeasurement (uint8_t dataPos) {
  gslc_tsElemRef* dataField[] = {
    dataTxt_1,
    dataTxt_2,
    dataTxt_3,
    dataTxt_4,
    dataTxt_5,
    dataTxt_6,
    dataTxt_7,
    dataTxt_8,
    dataTxt_9,
    dataTxt_10,
    dataTxt_11,
    dataTxt_12,
  };
  gslc_ElemSetTxtStr(&m_gui, (dataField[dataPos]) , tempBuf);
  gslc_ElemSetTxtCol(&m_gui, (dataField[dataPos]) , GSLC_COL_YELLOW);
  gslc_ElemSetGlow(&m_gui, (dataField [dataPos]), false);
  if (counter < 11) {
    gslc_ElemSetTxtCol(&m_gui, (dataField[dataPos + 1]) , GSLC_COL_WHITE);
    gslc_ElemSetGlow(&m_gui, (dataField[dataPos + 1]), true);
  }
  if (dataPos < 3) {
    gslc_ElemSetRedraw(&m_gui, frontLeft, GSLC_REDRAW_FULL);
  }
  if (dataPos >= 3 && dataPos < 6) {
    gslc_ElemSetRedraw(&m_gui, rearLeft, GSLC_REDRAW_FULL);
  }
  if (dataPos >= 6 && dataPos < 9) {
    gslc_ElemSetRedraw(&m_gui, rearRight, GSLC_REDRAW_FULL);
  }
  if (dataPos >= 9) {
    gslc_ElemSetRedraw(&m_gui, frontRight, GSLC_REDRAW_FULL);
  }
  if (dataPos == 11) {
    gslc_ElemSetTxtCol(&m_gui, (dataField[0]) , GSLC_COL_WHITE);
    gslc_ElemSetGlow(&m_gui, (dataField[0]), true);
  }
  dataConvertToInt ();
}

void DeleteMeasurement (uint8_t dataPos) {
  gslc_tsElemRef* dataField[] = {
    dataTxt_1,
    dataTxt_2,
    dataTxt_3,
    dataTxt_4,
    dataTxt_5,
    dataTxt_6,
    dataTxt_7,
    dataTxt_8,
    dataTxt_9,
    dataTxt_10,
    dataTxt_11,
    dataTxt_12,
  };
  gslc_ElemSetTxtStr(&m_gui, (dataField[dataPos + 1]) , nullnullval);
  gslc_ElemSetTxtCol(&m_gui, (dataField[dataPos]) , GSLC_COL_WHITE);
  gslc_ElemSetGlow(&m_gui, (dataField [dataPos]), true);
  gslc_ElemSetTxtCol(&m_gui, (dataField[dataPos + 1]) , GSLC_COL_YELLOW);
  gslc_ElemSetGlow(&m_gui, (dataField[dataPos + 1]), false);
}

void ResetLog() {
  gslc_tsElemRef* dataField[] = {
    dataTxt_1,
    dataTxt_2,
    dataTxt_3,
    dataTxt_4,
    dataTxt_5,
    dataTxt_6,
    dataTxt_7,
    dataTxt_8,
    dataTxt_9,
    dataTxt_10,
    dataTxt_11,
    dataTxt_12,
    avFrontTxt,
    avLeftTxt,
    avRearTxt,
    avRightTxt,
    deltaFLTxt,
    deltaRLTxt,
    deltaRRTxt,
    deltaFRTxt,
  };
  for (int i = 0; i < 20; i++) {
    if (i < 12) {
      gslc_ElemSetTxtStr(&m_gui, (dataField[i]) , nullnullval);
      gslc_ElemSetTxtCol(&m_gui, (dataField[i]) , GSLC_COL_YELLOW);
      gslc_ElemSetGlow(&m_gui, (dataField [i]), false);
    }
    else if (i > 12 && i < 16) {
      gslc_ElemSetTxtStr(&m_gui, (dataField[i]) , "&---.--");
    }
    else {
      gslc_ElemSetTxtStr(&m_gui, (dataField[i]) , "$---.--");
    }
  }
  gslc_ElemSetTxtCol(&m_gui, (dataField[0]) , GSLC_COL_WHITE);
  gslc_ElemSetGlow(&m_gui, (dataField [0]), true);
  dataConvertToInt ();
  counter = -1;
}

void dataConvertToInt () {
  gslc_tsElemRef* dataField[] = {
    dataTxt_1,
    dataTxt_2,
    dataTxt_3,
    dataTxt_4,
    dataTxt_5,
    dataTxt_6,
    dataTxt_7,
    dataTxt_8,
    dataTxt_9,
    dataTxt_10,
    dataTxt_11,
    dataTxt_12,
  };
  for (int i = 0; i < 12; i++) {
    if (atoi(gslc_ElemGetTxtStr(&m_gui, dataField[i])) != 0) {
      dataFieldInt[i] = atof (gslc_ElemGetTxtStr(&m_gui, dataField[i])) * 100;
    }
    else {
      dataFieldInt[i] = 0;
    }
  }
}

void GetStats () {
  uint8_t j = 0;
  for (uint8_t i = 0; i < 4; i++) {
    if (dataFieldInt [j] < dataFieldInt [j + 1] && dataFieldInt [j] < dataFieldInt [j + 2]) {
      cornerLowTemp[i] = dataFieldInt [j];
    }
    else if (dataFieldInt [j + 1] < dataFieldInt [j + 2]) {
      cornerLowTemp[i] = dataFieldInt [j + 1];
    }
    else {
      cornerLowTemp[i] = dataFieldInt [j + 2];
    }
    if (dataFieldInt [j] > dataFieldInt [j + 1] && dataFieldInt [j] > dataFieldInt [j + 2]) {
      cornerHighTemp[i] = dataFieldInt [j];
    }
    else if (dataFieldInt [j + 1] > dataFieldInt [j + 2]) {
      cornerHighTemp[i] = dataFieldInt [j + 1];
    }
    else {
      cornerHighTemp[i] = dataFieldInt [j + 2];
    }
    cornerDelta [i] = cornerHighTemp[i] - cornerLowTemp[i];
    cornerDelta [i] = cornerDelta [i] / 100;
    cornerAverage[i] = (dataFieldInt[j] + dataFieldInt[j + 1] + dataFieldInt[j + 2]);
    cornerAverage[i] = cornerAverage[i] / 3;
    j = j + 3;
  }
  j = 0;
  for (uint8_t i = 0; i < 4; i++) {
    if (i <= 2) {
      sideAverage [i] = cornerAverage [i] + cornerAverage [i + 1] ;
    }
    else if (i = 3) {
      sideAverage [i] = cornerAverage [i] + cornerAverage [0];
    }
    sideAverage [i] = sideAverage [i] / 200;

  }


}


void ShowStats(uint8_t dataPos) {
  GetStats();
  if (dataPos >= 2) {
    snprintf(deltaBuf, MAX_STR, "$%.2f", cornerDelta[FrontLeft]);
    gslc_ElemSetTxtStr (&m_gui, deltaFLTxt, deltaBuf);
  }
  if (dataPos >= 5) {
    snprintf(deltaBuf, MAX_STR, "$%.2f", cornerDelta[RearLeft]);
    gslc_ElemSetTxtStr (&m_gui, deltaRLTxt, deltaBuf);

    snprintf(averageBuf, MAX_STR, "&%.2f", sideAverage[Left]);
    gslc_ElemSetTxtStr(&m_gui, avLeftTxt, averageBuf);
  }
  if (dataPos >= 8) {
    snprintf(deltaBuf, MAX_STR, "$%.2f", cornerDelta[RearRight]);
    gslc_ElemSetTxtStr (&m_gui,  deltaRRTxt, deltaBuf);

    snprintf(averageBuf, MAX_STR, "&%.2f", sideAverage[Rear]);
    gslc_ElemSetTxtStr(&m_gui, avRearTxt, averageBuf);
  }
  if (dataPos >= 11) {
    snprintf(deltaBuf, MAX_STR, "$%.2f", cornerDelta[FrontRight]);
    gslc_ElemSetTxtStr (&m_gui, deltaFRTxt, deltaBuf);

    snprintf(averageBuf, MAX_STR, "&%.2f", sideAverage[Right]);
    gslc_ElemSetTxtStr(&m_gui, avRightTxt, averageBuf);

    snprintf(averageBuf, MAX_STR, "&%.2f", sideAverage[Front]);
    gslc_ElemSetTxtStr(&m_gui, avFrontTxt, averageBuf);
  }
}

void SetWheelPos (const uint8_t wheelPos) {
  gslc_tsElemRef* dataField[] = {
    dataTxt_1,
    dataTxt_2,
    dataTxt_3,
    dataTxt_4,
    dataTxt_5,
    dataTxt_6,
    dataTxt_7,
    dataTxt_8,
    dataTxt_9,
    dataTxt_10,
    dataTxt_11,
    dataTxt_12,
  };
  gslc_ElemSetTxtCol(&m_gui, (dataField[counter + 1]) , GSLC_COL_YELLOW);
  gslc_ElemSetGlow(&m_gui, (dataField [counter + 1]), false);
  gslc_ElemSetTxtCol(&m_gui, (dataField[(wheelPos * 3)]) , GSLC_COL_WHITE);
  gslc_ElemSetGlow(&m_gui, (dataField[wheelPos * 3]), true);
  counter = (wheelPos * 3) - 1;
}

void GetPressure () {
  abp.update();
  sensorPressure = abp.pressure();
  gaugePressure = (sensorPressure / 14.5038);
  gaugeVal = gaugePressure * 100;
}

void GetTemperature () {
  probeTemp = probe.getThermocoupleTemp();
  gaugeVal = probeTemp;
}
